## recipes-kernel/linux/files/defconfig
```kconfig
CONFIG_SYSVIPC=m
CONFIG_POSIX_MQUEUE=m
CONFIG_NO_HZ_IDLE=m
CONFIG_HIGH_RES_TIMERS=m
CONFIG_BPF_SYSCALL=m
CONFIG_BPF_JIT=m
CONFIG_PREEMPT=m
CONFIG_IRQ_TIME_ACCOUNTING=m
CONFIG_BSD_PROCESS_ACCT=m
CONFIG_BSD_PROCESS_ACCT_V3=m
CONFIG_IKCONFIG=m
CONFIG_IKCONFIG_PROC=m
CONFIG_NUMA_BALANCING=m
CONFIG_MEMCG=m
CONFIG_BLK_CGROUP=m
CONFIG_CFS_BANDWIDTH=m
CONFIG_RT_GROUP_SCHED=m
CONFIG_CGROUP_PIDS=m
CONFIG_CGROUP_FREEZER=m
CONFIG_CGROUP_HUGETLB=m
CONFIG_CPUSETS=m
CONFIG_CGROUP_DEVICE=m
CONFIG_CGROUP_CPUACCT=m
CONFIG_CGROUP_PERF=m
CONFIG_CGROUP_BPF=m
CONFIG_USER_NS=m
CONFIG_SCHED_AUTOGROUP=m
CONFIG_RELAY=m
CONFIG_BLK_DEV_INITRD=m
CONFIG_KALLSYMS_ALL=m
# CONFIG_COMPAT_BRK is not set
CONFIG_PROFILING=m
CONFIG_ARCH_LAYERSCAPE=m
CONFIG_ARCH_KEEMBAY=m
CONFIG_ARCH_MXC=m
CONFIG_ARCH_QCOM=m
CONFIG_ARCH_S32=m
CONFIG_SOC_S32V234=m
CONFIG_ARM64_VA_BITS_48=m
CONFIG_SCHED_MC=m
CONFIG_SCHED_SMT=m
CONFIG_NUMA=m
CONFIG_KEXEC=m
CONFIG_KEXEC_FILE=m
CONFIG_CRASH_DUMP=m
CONFIG_XEN=m
CONFIG_FORCE_MAX_ZONEORDER=14
CONFIG_COMPAT=m
CONFIG_RANDOMIZE_BASE=m
CONFIG_PM_DEBUG=m
CONFIG_PM_TEST_SUSPEND=m
CONFIG_WQ_POWER_EFFICIENT_DEFAULT=m
CONFIG_ENERGY_MODEL=m
CONFIG_ARM_CPUIDLE=m
CONFIG_ARM_PSCI_CPUIDLE=m
CONFIG_CPU_FREQ=m
CONFIG_CPU_FREQ_STAT=m
CONFIG_CPU_FREQ_DEFAULT_GOV_ONDEMAND=m
CONFIG_CPU_FREQ_GOV_POWERSAVE=m
CONFIG_CPU_FREQ_GOV_USERSPACE=m
CONFIG_CPU_FREQ_GOV_CONSERVATIVE=m
CONFIG_CPU_FREQ_GOV_SCHEDUTIL=m
CONFIG_CPUFREQ_DT=m
CONFIG_ACPI_CPPC_CPUFREQ=m
CONFIG_ARM_SCPI_CPUFREQ=m
CONFIG_ARM_REDACTED_CPUFREQ_DT=m
CONFIG_ARM_SCMI_CPUFREQ=m
CONFIG_QORIQ_CPUFREQ=m
CONFIG_ACPI=m
CONFIG_ACPI_APEI=m
CONFIG_ACPI_APEI_GHES=m
CONFIG_ACPI_APEI_MEMORY_FAILURE=m
CONFIG_ACPI_APEI_EINJ=m
CONFIG_VIRTUALIZATION=m
CONFIG_KVM=m
CONFIG_ARM64_CRYPTO=m
CONFIG_CRYPTO_SHA1_ARM64_CE=m
CONFIG_CRYPTO_SHA2_ARM64_CE=m
CONFIG_CRYPTO_SHA512_ARM64_CE=m
CONFIG_CRYPTO_SHA3_ARM64=m
CONFIG_CRYPTO_SM3_ARM64_CE=m
CONFIG_CRYPTO_GHASH_ARM64_CE=m
CONFIG_CRYPTO_CRCT10DIF_ARM64_CE=m
CONFIG_CRYPTO_AES_ARM64_CE_CCM=m
CONFIG_CRYPTO_AES_ARM64_CE_BLK=m
CONFIG_CRYPTO_CHACHA20_NEON=m
CONFIG_CRYPTO_AES_ARM64_BS=m
CONFIG_JUMP_LABEL=m
CONFIG_MODULES=m
CONFIG_MODULE_UNLOAD=m
CONFIG_MODVERSIONS=m
CONFIG_BLK_DEV_THROTTLING=m
# CONFIG_CORE_DUMP_DEFAULT_ELF_HEADERS is not set
CONFIG_KSM=m
CONFIG_MEMORY_FAILURE=m
CONFIG_TRANSPARENT_HUGEPAGE=m
CONFIG_NET=m
CONFIG_PACKET=m
CONFIG_UNIX=m
CONFIG_TLS=m
CONFIG_TLS_DEVICE=m
CONFIG_XFRM_USER=m
CONFIG_INET=m
CONFIG_IP_MULTICAST=m
CONFIG_IP_ADVANCED_ROUTER=m
CONFIG_IP_FIB_TRIE_STATS=m
CONFIG_IP_MULTIPLE_TABLES=m
CONFIG_IP_ROUTE_MULTIPATH=m
CONFIG_IP_ROUTE_VERBOSE=m
CONFIG_IP_PNP=m
CONFIG_IP_PNP_DHCP=m
CONFIG_IP_PNP_BOOTP=m
CONFIG_INET_ESP=m
CONFIG_IPV6_SIT=m
CONFIG_NETFILTER=m
CONFIG_BRIDGE_NETFILTER=m
CONFIG_NF_CONNTRACK=m
CONFIG_NF_CONNTRACK_EVENTS=m
CONFIG_NF_CONNTRACK_FTP=m
CONFIG_NF_CONNTRACK_TFTP=m
CONFIG_NF_TABLES=m
CONFIG_NETFILTER_XT_MARK=m
CONFIG_NETFILTER_XT_TARGET_CHECKSUM=m
CONFIG_NETFILTER_XT_TARGET_LOG=m
CONFIG_NETFILTER_XT_MATCH_ADDRTYPE=m
CONFIG_NETFILTER_XT_MATCH_CONNTRACK=m
CONFIG_NETFILTER_XT_MATCH_IPVS=m
CONFIG_IP_VS=m
CONFIG_IP_VS_PROTO_TCP=m
CONFIG_IP_VS_PROTO_UDP=m
CONFIG_IP_VS_RR=m
CONFIG_IP_VS_NFCT=m
CONFIG_IP_NF_IPTABLES=m
CONFIG_IP_NF_FILTER=m
CONFIG_IP_NF_TARGET_REJECT=m
CONFIG_IP_NF_NAT=m
CONFIG_IP_NF_TARGET_MASQUERADE=m
CONFIG_IP_NF_TARGET_REDIRECT=m
CONFIG_IP_NF_MANGLE=m
CONFIG_IP6_NF_IPTABLES=m
CONFIG_IP6_NF_FILTER=m
CONFIG_IP6_NF_TARGET_REJECT=m
CONFIG_IP6_NF_MANGLE=m
CONFIG_IP6_NF_NAT=m
CONFIG_IP6_NF_TARGET_MASQUERADE=m
CONFIG_BRIDGE=m
CONFIG_BRIDGE_VLAN_FILTERING=m
CONFIG_NET_DSA=m
CONFIG_VLAN_8021Q_GVRP=m
CONFIG_VLAN_8021Q_MVRP=m
CONFIG_LLC2=m
CONFIG_NET_SCHED=m
CONFIG_NET_SCH_MULTIQ=m
CONFIG_NET_SCH_CBS=m
CONFIG_NET_SCH_ETF=m
CONFIG_NET_SCH_TAPRIO=m
CONFIG_NET_SCH_MQPRIO=m
CONFIG_NET_SCH_INGRESS=m
CONFIG_NET_CLS_BASIC=m
CONFIG_NET_CLS_TCINDEX=m
CONFIG_NET_CLS_CGROUP=m
CONFIG_NET_CLS_FLOWER=m
CONFIG_NET_CLS_ACT=m
CONFIG_NET_ACT_GACT=m
CONFIG_NET_ACT_MIRRED=m
CONFIG_NET_ACT_GATE=m
CONFIG_TSN=m
CONFIG_QRTR=m
CONFIG_QRTR_SMD=m
CONFIG_QRTR_TUN=m
CONFIG_CGROUP_NET_PRIO=m
CONFIG_NET_PKTGEN=m
CONFIG_CAN=m
CONFIG_CAN_J1939=m
CONFIG_CAN_ISOTP=m
CONFIG_CAN_VCAN=m
CONFIG_CAN_VXCAN=m
CONFIG_CAN_SLCAN=m
CONFIG_CAN_FLEXCAN=m
CONFIG_CAN_HI311X=m
CONFIG_CAN_MCP251X=m
CONFIG_CAN_MCP251XFD=m
CONFIG_CAN_MCP251XFD_SANITY=m
CONFIG_CAN_8DEV_USB=m
CONFIG_CAN_EMS_USB=m
CONFIG_CAN_ESD_USB2=m
CONFIG_CAN_KVASER_USB=m
CONFIG_CAN_MCBA_USB=m
CONFIG_CAN_PEAK_USB=m
CONFIG_BT=m
CONFIG_BT_RFCOMM=m
CONFIG_BT_RFCOMM_TTY=m
CONFIG_BT_BNEP=m
CONFIG_BT_BNEP_MC_FILTER=m
CONFIG_BT_BNEP_PROTO_FILTER=m
CONFIG_BT_HIDP=m
CONFIG_BT_LEDS=m
# CONFIG_BT_DEBUGFS is not set
CONFIG_BT_HCIBTUSB=m
CONFIG_BT_HCIUART=m
CONFIG_BT_HCIUART_BCSP=m
CONFIG_BT_HCIUART_ATH3K=m
CONFIG_BT_HCIUART_LL=m
CONFIG_BT_HCIUART_3WIRE=m
CONFIG_BT_HCIUART_BCM=m
CONFIG_BT_HCIUART_QCA=m
CONFIG_BT_HCIVHCI=m
CONFIG_CFG80211=m
CONFIG_NL80211_TESTMODE=m
CONFIG_CFG80211_WEXT=m
CONFIG_MAC80211=m
CONFIG_MAC80211_LEDS=m
CONFIG_NET_9P=m
CONFIG_NET_9P_VIRTIO=m
CONFIG_NFC=m
CONFIG_NFC_NCI=m
CONFIG_NFC_S3FWRN5_I2C=m
CONFIG_PCI=m
CONFIG_PCIEPORTBUS=m
CONFIG_PCI_IOV=m
CONFIG_PCI_PASID=m
CONFIG_HOTPLUG_PCI=m
CONFIG_HOTPLUG_PCI_ACPI=m
CONFIG_PCI_HOST_GENERIC=m
CONFIG_PCI_XGENE=m
CONFIG_PCIE_ALTERA=m
CONFIG_PCIE_ALTERA_MSI=m
CONFIG_PCI_HOST_THUNDER_PEM=m
CONFIG_PCI_HOST_THUNDER_ECAM=m
CONFIG_PCI_REDACTED6_HOST=m
CONFIG_PCI_REDACTED6_EP=m
CONFIG_PCI_LAYERSCAPE=m
CONFIG_PCI_HISI=m
CONFIG_PCIE_KIRIN=m
CONFIG_PCI_MESON=m
CONFIG_PCIE_LAYERSCAPE_GEN4=m
CONFIG_PCI_ENDPOINT=m
CONFIG_PCI_ENDPOINT_CONFIGFS=m
CONFIG_PCI_EPF_TEST=m
CONFIG_PCCARD=m
CONFIG_DEVTMPFS=m
CONFIG_DEVTMPFS_MOUNT=m
CONFIG_FW_LOADER_USER_HELPER=m
CONFIG_BRCMSTB_GISB_ARB=m
CONFIG_VEXPRESS_CONFIG=m
CONFIG_FSL_MC_UAPI_SUPPORT=m
CONFIG_ARM_SCMI_PROTOCOL=m
CONFIG_ARM_SCPI_PROTOCOL=m
CONFIG_EFI_CAPSULE_LOADER=m
CONFIG_REDACTED_DSP=m
CONFIG_REDACTED_SCU=m
CONFIG_REDACTED_SCU_PD=m
CONFIG_GNSS=m
CONFIG_GNSS_MTK_SERIAL=m
CONFIG_GNSS_SIRF_SERIAL=m
CONFIG_GNSS_UBX_SERIAL=m
CONFIG_MTD=m
CONFIG_MTD_CMDLINE_PARTS=m
CONFIG_MTD_BLOCK=m
CONFIG_MTD_CFI=m
CONFIG_MTD_CFI_ADV_OPTIONS=m
CONFIG_MTD_CFI_INTELEXT=m
CONFIG_MTD_CFI_AMDSTD=m
CONFIG_MTD_CFI_STAA=m
CONFIG_MTD_PHYSMAP=m
CONFIG_MTD_PHYSMAP_OF=m
CONFIG_MTD_DATAFLASH=m
CONFIG_MTD_SST25L=m
CONFIG_MTD_RAW_NAND=m
CONFIG_MTD_NAND_DENALI_DT=m
CONFIG_MTD_NAND_GPMI_NAND=m
CONFIG_MTD_NAND_FSL_IFC=m
CONFIG_MTD_SPI_NOR=m
# CONFIG_MTD_SPI_NOR_USE_4K_SECTORS is not set
CONFIG_MTD_UBI=m
CONFIG_BLK_DEV_LOOP=m
CONFIG_BLK_DEV_NBD=m
CONFIG_XEN_BLKDEV_BACKEND=m
CONFIG_VIRTIO_BLK=m
CONFIG_BLK_DEV_NVME=m
CONFIG_SRAM=m
CONFIG_PCI_ENDPOINT_TEST=m
CONFIG_EEPROM_AT24=m
CONFIG_EEPROM_AT25=m
CONFIG_UACCE=m
# CONFIG_SCSI_PROC_FS is not set
CONFIG_BLK_DEV_SD=m
CONFIG_SCSI_SAS_ATA=m
CONFIG_SCSI_HISI_SAS=m
CONFIG_SCSI_HISI_SAS_PCI=m
CONFIG_MEGARAID_SAS=m
CONFIG_SCSI_MPT3SAS=m
CONFIG_SCSI_UFSHCD=m
CONFIG_SCSI_UFSHCD_PLATFORM=m
CONFIG_ATA=m
CONFIG_SATA_AHCI=m
CONFIG_SATA_AHCI_PLATFORM=m
CONFIG_AHCI_REDACTED=m
CONFIG_AHCI_CEVA=m
CONFIG_AHCI_XGENE=m
CONFIG_AHCI_QORIQ=m
CONFIG_SATA_SIL24=m
CONFIG_PATA_PLATFORM=m
CONFIG_PATA_OF_PLATFORM=m
CONFIG_MD=m
CONFIG_BLK_DEV_MD=m
CONFIG_BLK_DEV_DM=m
CONFIG_DM_CRYPT=m
CONFIG_DM_THIN_PROVISIONING=m
CONFIG_DM_MIRROR=m
CONFIG_DM_ZERO=m
CONFIG_NETDEVICES=m
CONFIG_DUMMY=m
CONFIG_MACVLAN=m
CONFIG_MACVTAP=m
CONFIG_IPVLAN=m
CONFIG_VXLAN=m
CONFIG_TUN=m
CONFIG_VETH=m
CONFIG_VIRTIO_NET=m
CONFIG_NET_DSA_MSCC_FELIX=m
CONFIG_AMD_XGBE=m
CONFIG_ATL1C=m
CONFIG_BCMGENET=m
CONFIG_BNX2X=m
CONFIG_MACB=m
CONFIG_THUNDER_NIC_PF=m
CONFIG_FEC=m
CONFIG_FEC_UIO=m
CONFIG_FSL_FMAN=m
CONFIG_FSL_DPAA_ETH=m
CONFIG_FSL_DPAA2_ETH=m
CONFIG_FSL_DPAA2_MAC=m
CONFIG_FSL_DPAA2_SWITCH=m
CONFIG_FSL_ENETC=m
CONFIG_FSL_ENETC_VF=m
CONFIG_FSL_ENETC_QOS=m
CONFIG_ENETC_TSN=m
CONFIG_HIX5HD2_GMAC=m
CONFIG_HNS_DSAF=m
CONFIG_HNS_ENET=m
CONFIG_HNS3=m
CONFIG_HNS3_HCLGE=m
CONFIG_HNS3_ENET=m
CONFIG_E1000=m
CONFIG_E1000E=m
CONFIG_IGB=m
CONFIG_IGBVF=m
CONFIG_MVMDIO=m
CONFIG_SKY2=m
CONFIG_MLX4_EN=m
CONFIG_MLX5_CORE=m
CONFIG_MLX5_CORE_EN=m
CONFIG_MSCC_OCELOT_SWITCH=m
CONFIG_QCOM_EMAC=m
CONFIG_RMNET=m
CONFIG_SMC91X=m
CONFIG_SMSC911X=m
CONFIG_STMMAC_ETH=m
CONFIG_DWMAC_GENERIC=m
CONFIG_LED_TRIGGER_PHY=m
CONFIG_ADIN_PHY=m
CONFIG_AQUANTIA_PHY=m
CONFIG_BROADCOM_PHY=m
CONFIG_BCM54140_PHY=m
CONFIG_INPHI_PHY=m
CONFIG_MARVELL_PHY=m
CONFIG_MARVELL_10G_PHY=m
CONFIG_MICREL_PHY=m
CONFIG_MICROSEMI_PHY=m
CONFIG_NXP_TJA11XX_PHY=m
CONFIG_AT803X_PHY=m
CONFIG_REALTEK_PHY=m
CONFIG_ROCKCHIP_PHY=m
CONFIG_VITESSE_PHY=m
CONFIG_MDIO_BITBANG=m
CONFIG_MDIO_BUS_MUX_MULTIPLEXER=m
CONFIG_MDIO_BUS_MUX_MMIOREG=m
CONFIG_USB_PEGASUS=m
CONFIG_USB_RTL8150=m
CONFIG_USB_RTL8152=m
CONFIG_USB_LAN78XX=m
CONFIG_USB_USBNET=m
CONFIG_USB_NET_AX8817X=m
CONFIG_USB_NET_AX88179_178A=m
CONFIG_USB_NET_CDCETHER=m
CONFIG_USB_NET_CDC_EEM=m
CONFIG_USB_NET_CDC_NCM=m
CONFIG_USB_NET_DM9601=m
CONFIG_USB_NET_SR9800=m
CONFIG_USB_NET_SMSC75XX=m
CONFIG_USB_NET_SMSC95XX=m
CONFIG_USB_NET_NET1080=m
CONFIG_USB_NET_PLUSB=m
CONFIG_USB_NET_MCS7830=m
CONFIG_USB_NET_CDC_SUBSET=m
CONFIG_USB_NET_ZAURUS=m
CONFIG_USB_SIERRA_NET=m
CONFIG_BRCMFMAC=m
CONFIG_HOSTAP=m
CONFIG_RTL8180=m
CONFIG_RTL8187=m
CONFIG_RTL8XXXU=m
CONFIG_RTW88=m
CONFIG_WL18XX=m
CONFIG_WLCORE_SDIO=m
CONFIG_WWAN=m
CONFIG_XEN_NETDEV_BACKEND=m
CONFIG_IVSHMEM_NET=m
CONFIG_INPUT_EVDEV=m
CONFIG_KEYBOARD_ADC=m
CONFIG_KEYBOARD_GPIO=m
CONFIG_KEYBOARD_RPMSG=m
CONFIG_KEYBOARD_SNVS_PWRKEY=m
CONFIG_KEYBOARD_BBNSM_PWRKEY=m
CONFIG_KEYBOARD_REDACTED_SC_PWRKEY=m
CONFIG_KEYBOARD_CROS_EC=m
CONFIG_INPUT_TOUCHSCREEN=m
CONFIG_TOUCHSCREEN_ADS7846=m
CONFIG_TOUCHSCREEN_ATMEL_MXT=m
CONFIG_TOUCHSCREEN_EXC3000=m
CONFIG_TOUCHSCREEN_GOODIX=m
CONFIG_TOUCHSCREEN_EDT_FT5X06=m
CONFIG_TOUCHSCREEN_SYNAPTICS_DSX_I2C=m
CONFIG_INPUT_MISC=m
CONFIG_INPUT_PWM_VIBRA=m
# CONFIG_SERIO_SERPORT is not set
CONFIG_SERIO_AMBAKMI=m
CONFIG_LEGACY_PTY_COUNT=16
CONFIG_SERIAL_8250=m
CONFIG_SERIAL_8250_CONSOLE=m
CONFIG_SERIAL_8250_EXTENDED=m
CONFIG_SERIAL_8250_SHARE_IRQ=m
CONFIG_SERIAL_8250_DW=m
CONFIG_SERIAL_OF_PLATFORM=m
CONFIG_SERIAL_AMBA_PL011=m
CONFIG_SERIAL_AMBA_PL011_CONSOLE=m
CONFIG_SERIAL_REDACTED=m
CONFIG_SERIAL_REDACTED_CONSOLE=m
CONFIG_SERIAL_XILINX_PS_UART=m
CONFIG_SERIAL_XILINX_PS_UART_CONSOLE=m
CONFIG_SERIAL_FSL_LPUART=m
CONFIG_SERIAL_FSL_LPUART_CONSOLE=m
CONFIG_SERIAL_FSL_LINFLEXUART=m
CONFIG_SERIAL_FSL_LINFLEXUART_CONSOLE=m
CONFIG_SERIAL_DEV_BUS=m
CONFIG_VIRTIO_CONSOLE=m
CONFIG_IPMI_HANDLER=m
CONFIG_IPMI_DEVICE_INTERFACE=m
CONFIG_IPMI_SI=m
CONFIG_TCG_TPM=m
CONFIG_TCG_TIS_I2C_INFINEON=m
CONFIG_I2C_CHARDEV=m
CONFIG_I2C_MUX=m
CONFIG_I2C_MUX_PCA954x=m
CONFIG_I2C_DESIGNWARE_PLATFORM=m
CONFIG_I2C_GPIO=m
CONFIG_I2C_REDACTED=m
CONFIG_I2C_REDACTED_LPI2C=m
CONFIG_I2C_RK3X=m
CONFIG_I2C_RPBUS=m
CONFIG_I2C_CROS_EC_TUNNEL=m
CONFIG_XEN_I2C_BACKEND=m
CONFIG_I3C=m
CONFIG_SVC_I3C_MASTER=m
CONFIG_SPI=m
CONFIG_SPI_CADENCE_QUADSPI=m
CONFIG_SPI_DESIGNWARE=m
CONFIG_SPI_DW_DMA=m
CONFIG_SPI_DW_MMIO=m
CONFIG_SPI_FSL_LPSPI=m
CONFIG_SPI_FSL_QUADSPI=m
CONFIG_SPI_NXP_FLEXSPI=m
CONFIG_SPI_REDACTED=m
CONFIG_SPI_FSL_DSPI=m
CONFIG_SPI_PL022=m
CONFIG_SPI_ROCKCHIP=m
CONFIG_SPI_SPIDEV=m
CONFIG_SPI_SLAVE=m
CONFIG_SPI_SLAVE_TIME=m
CONFIG_SPI_SLAVE_SYSTEM_CONTROL=m
CONFIG_SPMI=m
CONFIG_PINCTRL_SINGLE=m
CONFIG_PINCTRL_MAX77620=m
CONFIG_PINCTRL_REDACTED8MM=m
CONFIG_PINCTRL_REDACTED8MN=m
CONFIG_PINCTRL_REDACTED8MP=m
CONFIG_PINCTRL_REDACTED8MQ=m
CONFIG_PINCTRL_REDACTED8QM=m
CONFIG_PINCTRL_REDACTED8QXP=m
CONFIG_PINCTRL_REDACTED8DXL=m
CONFIG_PINCTRL_REDACTED8ULP=m
CONFIG_PINCTRL_REDACTED93=m
CONFIG_PINCTRL_S32V234=m
CONFIG_PINCTRL_MSM=m
CONFIG_PINCTRL_MDM9607=m
CONFIG_GPIO_ALTERA=m
CONFIG_GPIO_DWAPB=m
CONFIG_GPIO_MB86S7X=m
CONFIG_GPIO_MPC8XXX=m
CONFIG_GPIO_PL061=m
CONFIG_GPIO_REDACTED_RPMSG=m
CONFIG_GPIO_WCD934X=m
CONFIG_GPIO_XGENE=m
CONFIG_GPIO_MAX732X=m
CONFIG_GPIO_PCA953X=m
CONFIG_GPIO_PCA953X_IRQ=m
CONFIG_GPIO_ADP5585=m
CONFIG_GPIO_BD9571MWV=m
CONFIG_GPIO_MAX77620=m
CONFIG_GPIO_SL28CPLD=m
CONFIG_POWER_RESET_BRCMSTB=m
CONFIG_POWER_RESET_XGENE=m
CONFIG_POWER_RESET_SYSCON=m
CONFIG_SYSCON_REBOOT_MODE=m
CONFIG_BATTERY_SBS=m
CONFIG_BATTERY_BQ27XXX=m
CONFIG_BATTERY_MAX17042=m
CONFIG_CHARGER_BQ25890=m
CONFIG_CHARGER_BQ25980=m
CONFIG_SENSORS_ARM_SCMI=m
CONFIG_SENSORS_ARM_SCPI=m
CONFIG_SENSORS_FP9931=m
CONFIG_SENSORS_LM90=m
CONFIG_SENSORS_PWM_FAN=m
CONFIG_SENSORS_SL28CPLD=m
CONFIG_SENSORS_INA2XX=m
CONFIG_SENSORS_INA3221=m
CONFIG_THERMAL_WRITABLE_TRIPS=m
CONFIG_THERMAL_GOV_POWER_ALLOCATOR=m
CONFIG_CPU_THERMAL=m
CONFIG_THERMAL_EMULATION=m
CONFIG_REDACTED_SC_THERMAL=m
CONFIG_REDACTED8MM_THERMAL=m
CONFIG_DEVICE_THERMAL=m
CONFIG_QORIQ_THERMAL=m
CONFIG_WATCHDOG=m
CONFIG_SL28CPLD_WATCHDOG=m
CONFIG_ARM_SP805_WATCHDOG=m
CONFIG_ARM_SBSA_WATCHDOG=m
CONFIG_DW_WATCHDOG=m
CONFIG_REDACTED2_WDT=m
CONFIG_REDACTED_SC_WDT=m
CONFIG_REDACTED7ULP_WDT=m
CONFIG_ARM_SMC_WATCHDOG=m
CONFIG_XEN_WDT=m
CONFIG_MFD_ADP5585=m
CONFIG_MFD_BD9571MWV=m
CONFIG_MFD_AXP20X_I2C=m
CONFIG_MFD_REDACTED_MIX=m
CONFIG_MFD_HI6421_PMIC=m
CONFIG_MFD_FP9931=m
CONFIG_MFD_MAX77620=m
CONFIG_MFD_MT6397=m
CONFIG_MFD_RK808=m
CONFIG_MFD_SEC_CORE=m
CONFIG_MFD_SL28CPLD=m
CONFIG_MFD_ROHM_BD718XX=m
CONFIG_MFD_WCD934X=m
CONFIG_REGULATOR_FIXED_VOLTAGE=m
CONFIG_REGULATOR_AXP20X=m
CONFIG_REGULATOR_BD718XX=m
CONFIG_REGULATOR_BD9571MWV=m
CONFIG_REGULATOR_FAN53555=m
CONFIG_REGULATOR_GPIO=m
CONFIG_REGULATOR_HI6421V530=m
CONFIG_REGULATOR_MAX77620=m
CONFIG_REGULATOR_MAX8973=m
CONFIG_REGULATOR_FP9931=m
CONFIG_REGULATOR_MP8859=m
CONFIG_REGULATOR_MT6358=m
CONFIG_REGULATOR_MT6397=m
CONFIG_REGULATOR_PCA9450=m
CONFIG_REGULATOR_PF8X00=m
CONFIG_REGULATOR_PFUZE100=m
CONFIG_REGULATOR_PWM=m
CONFIG_REGULATOR_QCOM_SPMI=m
CONFIG_REGULATOR_RK808=m
CONFIG_REGULATOR_S2MPS11=m
CONFIG_REGULATOR_TPS65132=m
CONFIG_REGULATOR_VCTRL=m
CONFIG_RC_CORE=m
CONFIG_RC_DECODERS=m
CONFIG_IR_NEC_DECODER=m
CONFIG_IR_RC5_DECODER=m
CONFIG_IR_RC6_DECODER=m
CONFIG_IR_JVC_DECODER=m
CONFIG_IR_SONY_DECODER=m
CONFIG_IR_SANYO_DECODER=m
CONFIG_IR_SHARP_DECODER=m
CONFIG_IR_MCE_KBD_DECODER=m
CONFIG_IR_XMP_DECODER=m
CONFIG_IR_IMON_DECODER=m
CONFIG_IR_RCMM_DECODER=m
CONFIG_RC_DEVICES=m
CONFIG_IR_GPIO_CIR=m
CONFIG_MEDIA_SUPPORT=m
CONFIG_MEDIA_CAMERA_SUPPORT=m
CONFIG_MEDIA_ANALOG_TV_SUPPORT=m
CONFIG_MEDIA_DIGITAL_TV_SUPPORT=m
CONFIG_MEDIA_SDR_SUPPORT=m
CONFIG_MEDIA_PLATFORM_SUPPORT=m
# CONFIG_DVB_NET is not set
CONFIG_MEDIA_USB_SUPPORT=m
CONFIG_USB_VIDEO_CLASS=m
CONFIG_V4L_PLATFORM_DRIVERS=m
CONFIG_VIDEO_REDACTED8_JPEG=m
CONFIG_VIDEO_AMPHION_VPU=m
CONFIG_VIDEO_MXC_CAPTURE=m
CONFIG_VIDEO_MX8_CAPTURE=m
CONFIG_VIDEO_MXC_CSI_CAMERA=m
CONFIG_MXC_MIPI_CSI=m
CONFIG_MXC_CAMERA_OV5640_MIPI_V2=m
CONFIG_V4L_MEM2MEM_DRIVERS=m
CONFIG_SDR_PLATFORM_DRIVERS=m
CONFIG_VIDEO_REDACTED219=m
CONFIG_VIDEO_OV5640=m
CONFIG_VIDEO_OV5645=m
CONFIG_VIDEO_MT9M114=m
CONFIG_VIDEO_AP1302=m
CONFIG_REDACTED_DPU_CORE=m
CONFIG_REDACTED_LCDIF_CORE=m
CONFIG_REDACTED_LCDIFV3_CORE=m
CONFIG_DRM=m
CONFIG_DRM_I2C_NXP_TDA998X=m
CONFIG_DRM_MALI_DISPLAY=m
CONFIG_DRM_NOUVEAU=m
CONFIG_DRM_RCAR_DW_HDMI=m
CONFIG_DRM_RCAR_LVDS=m
CONFIG_DRM_PANEL_BOE_TV101WUM_NL6=m
CONFIG_DRM_PANEL_LVDS=m
CONFIG_DRM_PANEL_SIMPLE=m
CONFIG_DRM_PANEL_MANTIX_MLAF057WE51=m
CONFIG_DRM_PANEL_ONTAT_KD50G21_40NT_A1=m
CONFIG_DRM_PANEL_RAYDIUM_RM67191=m
CONFIG_DRM_PANEL_RAYDIUM_RM68200=m
CONFIG_DRM_PANEL_ROCKTECK_HIMAX8394F=m
CONFIG_DRM_PANEL_SEIKO_43WVF1G=m
CONFIG_DRM_PANEL_SITRONIX_ST7703=m
CONFIG_DRM_PANEL_TRULY_NT35597_WQXGA=m
CONFIG_DRM_PANEL_WKS_101WX001=m
CONFIG_DRM_DISPLAY_CONNECTOR=m
CONFIG_DRM_LONTIUM_LT8912B=m
CONFIG_DRM_LONTIUM_LT9611=m
CONFIG_DRM_LONTIUM_LT9611UXC=m
CONFIG_DRM_FSL_REDACTED_LVDS_BRIDGE=m
CONFIG_DRM_NWL_MIPI_DSI=m
CONFIG_DRM_NXP_SEIKO_43WVFIG=m
CONFIG_DRM_PARADE_PS8640=m
CONFIG_DRM_SII902X=m
CONFIG_DRM_SIMPLE_BRIDGE=m
CONFIG_DRM_THINE_THC63LVD1024=m
CONFIG_DRM_TI_SN65DSI83=m
CONFIG_DRM_TI_SN65DSI86=m
CONFIG_DRM_I2C_ADV7511=m
CONFIG_DRM_I2C_ADV7511_AUDIO=m
CONFIG_DRM_CDNS_HDCP=m
CONFIG_DRM_DW_HDMI_AHB_AUDIO=m
CONFIG_DRM_DW_HDMI_I2S_AUDIO=m
CONFIG_DRM_DW_HDMI_GP_AUDIO=m
CONFIG_DRM_DW_HDMI_CEC=m
CONFIG_DRM_ITE_IT6263=m
CONFIG_DRM_ITE_IT6161=m
CONFIG_DRM_REDACTED=m
CONFIG_DRM_REDACTED_LCDIF_MUX_DISPLAY=m
CONFIG_DRM_REDACTED_PARALLEL_DISPLAY=m
CONFIG_DRM_REDACTED_TVE=m
CONFIG_DRM_REDACTED_LDB=m
CONFIG_DRM_REDACTED8QM_LDB=m
CONFIG_DRM_REDACTED8QXP_LDB=m
CONFIG_DRM_REDACTED8MP_LDB=m
CONFIG_DRM_REDACTED93_LDB=m
CONFIG_DRM_REDACTED93_PARALLEL_DISPLAY_FORMAT=m
CONFIG_DRM_REDACTED_DW_MIPI_DSI=m
CONFIG_DRM_REDACTED_HDMI=m
CONFIG_DRM_REDACTED_SEC_DSIM=m
CONFIG_DRM_REDACTED_DCNANO=m
CONFIG_DRM_REDACTED_DCSS=m
CONFIG_DRM_REDACTED_CDNS_MHDP=m
CONFIG_DRM_ETNAVIV=m
CONFIG_DRM_HISI_HIBMC=m
CONFIG_DRM_HISI_KIRIN=m
CONFIG_DRM_MXSFB=m
CONFIG_DRM_PL111=m
CONFIG_DRM_LIMA=m
CONFIG_DRM_PANFROST=m
CONFIG_FB=m
CONFIG_FB_ARMCLCD=m
CONFIG_FB_EFI=m
CONFIG_FB_MXC_EINK_V2_PANEL=m
CONFIG_BACKLIGHT_PWM=m
CONFIG_BACKLIGHT_LP855X=m
CONFIG_BACKLIGHT_GPIO=m
CONFIG_LOGO=m
# CONFIG_LOGO_LINUX_MONO is not set
# CONFIG_LOGO_LINUX_VGA16 is not set
CONFIG_SOUND=m
CONFIG_SND=m
CONFIG_SND_ALOOP=m
CONFIG_SND_USB_AUDIO=m
CONFIG_SND_SOC=m
CONFIG_SND_SOC_FSL_ASRC=m
CONFIG_SND_SOC_FSL_MQS=m
CONFIG_SND_SOC_FSL_MICFIL=m
CONFIG_SND_SOC_FSL_EASRC=m
CONFIG_SND_SOC_FSL_XCVR=m
CONFIG_SND_SOC_FSL_ESAI_CLIENT=m
CONFIG_SND_SOC_FSL_RPMSG=m
CONFIG_SND_REDACTED_SOC=m
CONFIG_SND_SOC_REDACTED_SGTL5000=m
CONFIG_SND_SOC_REDACTED_SPDIF=m
CONFIG_SND_SOC_FSL_ASOC_CARD=m
CONFIG_SND_SOC_REDACTED_AUDMIX=m
CONFIG_SND_SOC_REDACTED_HDMI=m
CONFIG_SND_SOC_REDACTED_CARD=m
CONFIG_SND_SOC_REDACTED_PDM_MIC=m
CONFIG_SND_SOC_REDACTED_PCM512X=m
CONFIG_SND_SOC_SOF_TOPLEVEL=m
CONFIG_SND_SOC_SOF_OF=m
CONFIG_SND_SOC_SOF_REDACTED_TOPLEVEL=m
CONFIG_SND_SOC_SOF_REDACTED8=m
CONFIG_SND_SOC_SOF_REDACTED8M=m
CONFIG_SND_SOC_SOF_REDACTED8ULP=m
CONFIG_SND_SOC_AK4613=m
CONFIG_SND_SOC_BT_SCO=m
CONFIG_SND_SOC_CROS_EC_CODEC=m
CONFIG_SND_SOC_CS42XX8_I2C=m
CONFIG_SND_SOC_DMIC=m
CONFIG_SND_SOC_ES7134=m
CONFIG_SND_SOC_ES7241=m
CONFIG_SND_SOC_GTM601=m
CONFIG_SND_SOC_MAX98357A=m
CONFIG_SND_SOC_MAX98927=m
CONFIG_SND_SOC_MSM8916_WCD_ANALOG=m
CONFIG_SND_SOC_MSM8916_WCD_DIGITAL=m
CONFIG_SND_SOC_PCM3168A_I2C=m
CONFIG_SND_SOC_RT5659=m
CONFIG_SND_SOC_SIMPLE_AMPLIFIER=m
CONFIG_SND_SOC_SIMPLE_MUX=m
CONFIG_SND_SOC_SPDIF=m
CONFIG_SND_SOC_TAS571X=m
CONFIG_SND_SOC_WCD934X=m
CONFIG_SND_SOC_WM8524=m
CONFIG_SND_SOC_WM8904=m
CONFIG_SND_SOC_WM8960=m
CONFIG_SND_SOC_WM8962=m
CONFIG_SND_SOC_WSA881X=m
CONFIG_SND_SOC_RPMSG_WM8960=m
CONFIG_SND_SOC_RPMSG_AK4497=m
CONFIG_SND_SOC_LPASS_WSA_MACRO=m
CONFIG_SND_SOC_LPASS_VA_MACRO=m
CONFIG_SND_SIMPLE_CARD=m
CONFIG_SND_AUDIO_GRAPH_CARD=m
CONFIG_HIDRAW=m
CONFIG_HID_MULTITOUCH=m
CONFIG_USB_HIDDEV=m
CONFIG_I2C_HID_ACPI=m
CONFIG_I2C_HID_OF=m
CONFIG_USB_ULPI_BUS=m
CONFIG_USB_CONN_GPIO=m
CONFIG_USB=m
CONFIG_USB_OTG=m
CONFIG_USB_XHCI_HCD=m
CONFIG_USB_XHCI_PCI_RENESAS=m
CONFIG_USB_EHCI_HCD=m
CONFIG_USB_EHCI_HCD_PLATFORM=m
CONFIG_USB_OHCI_HCD=m
CONFIG_USB_OHCI_HCD_PLATFORM=m
CONFIG_USB_HCD_TEST_MODE=m
CONFIG_USB_ACM=m
CONFIG_USB_WDM=m
CONFIG_USB_STORAGE=m
CONFIG_USB_UAS=m
CONFIG_USB_CDNS_SUPPORT=m
CONFIG_USB_CDNS3=m
CONFIG_USB_CDNS3_GADGET=m
CONFIG_USB_CDNS3_HOST=m
CONFIG_USB_MUSB_HDRC=m
CONFIG_USB_DWC3=m
CONFIG_USB_DWC2=m
CONFIG_USB_CHIPIDEA=m
CONFIG_USB_CHIPIDEA_UDC=m
CONFIG_USB_CHIPIDEA_HOST=m
CONFIG_USB_ISP1760=m
CONFIG_USB_SERIAL=m
CONFIG_USB_SERIAL_CONSOLE=m
CONFIG_USB_SERIAL_GENERIC=m
CONFIG_USB_SERIAL_SIMPLE=m
CONFIG_USB_SERIAL_CP210X=m
CONFIG_USB_SERIAL_FTDI_SIO=m
CONFIG_USB_SERIAL_OPTION=m
CONFIG_USB_TEST=m
CONFIG_USB_EHSET_TEST_FIXTURE=m
CONFIG_USB_HSIC_USB3503=m
CONFIG_NOP_USB_XCEIV=m
CONFIG_USB_MXS_PHY=m
CONFIG_USB_ULPI=m
CONFIG_USB_GADGET=m
CONFIG_USB_SNP_UDC_PLAT=m
CONFIG_USB_BDC_UDC=m
CONFIG_USB_CONFIGFS=m
CONFIG_USB_CONFIGFS_SERIAL=m
CONFIG_USB_CONFIGFS_ACM=m
CONFIG_USB_CONFIGFS_OBEX=m
CONFIG_USB_CONFIGFS_NCM=m
CONFIG_USB_CONFIGFS_ECM=m
CONFIG_USB_CONFIGFS_ECM_SUBSET=m
CONFIG_USB_CONFIGFS_RNDIS=m
CONFIG_USB_CONFIGFS_EEM=m
CONFIG_USB_CONFIGFS_MASS_STORAGE=m
CONFIG_USB_CONFIGFS_F_LB_SS=m
CONFIG_USB_CONFIGFS_F_FS=m
CONFIG_USB_CONFIGFS_F_UAC1=m
CONFIG_USB_CONFIGFS_F_UAC1_LEGACY=m
CONFIG_USB_CONFIGFS_F_UAC2=m
CONFIG_USB_CONFIGFS_F_MIDI=m
CONFIG_USB_CONFIGFS_F_HID=m
CONFIG_USB_CONFIGFS_F_UVC=m
CONFIG_USB_ZERO=m
CONFIG_USB_AUDIO=m
CONFIG_USB_ETH=m
CONFIG_USB_MASS_STORAGE=m
CONFIG_USB_G_SERIAL=m
CONFIG_TYPEC=m
CONFIG_TYPEC_TCPM=m
CONFIG_TYPEC_TCPCI=m
CONFIG_TYPEC_FUSB302=m
CONFIG_TYPEC_TPS6598X=m
CONFIG_TYPEC_HD3SS3220=m
CONFIG_TYPEC_SWITCH_GPIO=m
CONFIG_MMC=m
CONFIG_MMC_BLOCK_MINORS=32
CONFIG_MMC_ARMMMCI=m
CONFIG_MMC_SDHCI=m
CONFIG_MMC_SDHCI_ACPI=m
CONFIG_MMC_SDHCI_PLTFM=m
CONFIG_MMC_SDHCI_OF_ARASAN=m
CONFIG_MMC_SDHCI_OF_ESDHC=m
CONFIG_MMC_SDHCI_CADENCE=m
CONFIG_MMC_SDHCI_ESDHC_REDACTED=m
CONFIG_MMC_SDHCI_F_SDH30=m
CONFIG_MMC_SPI=m
CONFIG_MMC_DW=m
CONFIG_MMC_DW_EXYNOS=m
CONFIG_MMC_DW_HI3798CV200=m
CONFIG_MMC_DW_K3=m
CONFIG_MMC_MTK=m
CONFIG_MMC_SDHCI_XENON=m
CONFIG_MMC_SDHCI_AM654=m
CONFIG_NEW_LEDS=m
CONFIG_LEDS_CLASS=m
CONFIG_LEDS_LM3692X=m
CONFIG_LEDS_PCA9532=m
CONFIG_LEDS_GPIO=m
CONFIG_LEDS_PCA995X=m
CONFIG_LEDS_PWM=m
CONFIG_LEDS_SYSCON=m
CONFIG_LEDS_TRIGGER_TIMER=m
CONFIG_LEDS_TRIGGER_DISK=m
CONFIG_LEDS_TRIGGER_HEARTBEAT=m
CONFIG_LEDS_TRIGGER_CPU=m
CONFIG_LEDS_TRIGGER_DEFAULT_ON=m
CONFIG_LEDS_TRIGGER_PANIC=m
CONFIG_EDAC=m
CONFIG_EDAC_GHES=m
CONFIG_EDAC_LAYERSCAPE=m
CONFIG_EDAC_SYNOPSYS=m
CONFIG_RTC_CLASS=m
CONFIG_RTC_DRV_DS1307=m
CONFIG_RTC_DRV_HYM8563=m
CONFIG_RTC_DRV_MAX77686=m
CONFIG_RTC_DRV_RK808=m
CONFIG_RTC_DRV_PCF85363=m
CONFIG_RTC_DRV_M41T80=m
CONFIG_RTC_DRV_RX8581=m
CONFIG_RTC_DRV_RV3028=m
CONFIG_RTC_DRV_RV8803=m
CONFIG_RTC_DRV_S5M=m
CONFIG_RTC_DRV_DS3232=m
CONFIG_RTC_DRV_PCF2127=m
CONFIG_RTC_DRV_EFI=m
CONFIG_RTC_DRV_CROS_EC=m
CONFIG_RTC_DRV_FSL_FTM_ALARM=m
CONFIG_RTC_DRV_PL031=m
CONFIG_RTC_DRV_SNVS=m
CONFIG_RTC_DRV_BBNSM=m
CONFIG_RTC_DRV_REDACTED_SC=m
CONFIG_RTC_DRV_REDACTED_RPMSG=m
CONFIG_DMADEVICES=m
CONFIG_BCM_SBA_RAID=m
CONFIG_FSL_EDMA=m
CONFIG_FSL_QDMA=m
CONFIG_FSL_EDMA_V3=m
CONFIG_REDACTED_SDMA=m
CONFIG_MV_XOR_V2=m
CONFIG_MXS_DMA=m
CONFIG_MXC_PXP_V3=m
CONFIG_PL330_DMA=m
CONFIG_QCOM_HIDMA_MGMT=m
CONFIG_QCOM_HIDMA=m
CONFIG_FSL_DPAA2_QDMA=m
CONFIG_DMATEST=m
CONFIG_DMABUF_HEAPS=m
CONFIG_DMABUF_HEAPS_SYSTEM=m
CONFIG_DMABUF_HEAPS_CMA=m
CONFIG_DMABUF_HEAPS_DSP=m
CONFIG_UIO_PCI_GENERIC=m
CONFIG_UIO_IVSHMEM=m
CONFIG_VFIO=m
CONFIG_VFIO_PCI=m
CONFIG_VFIO_FSL_MC=m
CONFIG_VIRTIO_PCI=m
CONFIG_VIRTIO_BALLOON=m
CONFIG_VIRTIO_MMIO=m
CONFIG_VIRTIO_IVSHMEM=m
CONFIG_XEN_GNTDEV=m
CONFIG_XEN_GRANT_DEV_ALLOC=m
CONFIG_STAGING=m
CONFIG_STAGING_MEDIA=m
CONFIG_VIDEO_HANTRO=m
CONFIG_VIDEO_REDACTED_CAPTURE=m
CONFIG_REDACTED8_MEDIA_DEVICE=m
CONFIG_MHDP_HDMIRX=m
CONFIG_MHDP_HDMIRX_CEC=m
CONFIG_FSL_DPAA2=m
CONFIG_FSL_PPFE=m
CONFIG_FSL_PPFE_UTIL_DISABLED=m
CONFIG_ETHOSU=m
CONFIG_CHROME_PLATFORMS=m
CONFIG_CROS_EC=m
CONFIG_CROS_EC_I2C=m
CONFIG_CROS_EC_SPI=m
CONFIG_CROS_EC_CHARDEV=m
CONFIG_CLK_VEXPRESS_OSC=m
CONFIG_COMMON_CLK_RK808=m
CONFIG_COMMON_CLK_SCMI=m
CONFIG_COMMON_CLK_SCPI=m
CONFIG_COMMON_CLK_CS2000_CP=m
CONFIG_COMMON_CLK_FSL_SAI=m
CONFIG_COMMON_CLK_S2MPS11=m
CONFIG_COMMON_CLK_XGENE=m
CONFIG_COMMON_CLK_PWM=m
CONFIG_COMMON_CLK_VC5=m
CONFIG_CLK_REDACTED8MM=m
CONFIG_CLK_REDACTED8MN=m
CONFIG_CLK_REDACTED8MP=m
CONFIG_CLK_REDACTED8MQ=m
CONFIG_CLK_REDACTED8QXP=m
CONFIG_CLK_REDACTED8ULP=m
CONFIG_CLK_REDACTED93=m
CONFIG_COMMON_CLK_QCOM=m
CONFIG_MDM_GCC_9607=m
CONFIG_HWSPINLOCK=m
CONFIG_ARM_MHU=m
CONFIG_REDACTED_MBOX=m
CONFIG_PLATFORM_MHU=m
CONFIG_IOMMU_IO_PGTABLE_ARMV7S=m
CONFIG_ARM_SMMU=m
CONFIG_ARM_SMMU_V3=m
CONFIG_REMOTEPROC=m
CONFIG_REDACTED_REMOTEPROC=m
CONFIG_REDACTED_DSP_REMOTEPROC=m
CONFIG_RPMSG_CHAR=m
CONFIG_RPMSG_QCOM_GLINK_RPM=m
CONFIG_SOUNDWIRE=m
CONFIG_SOUNDWIRE_QCOM=m
CONFIG_SOC_BRCMSTB=m
CONFIG_FSL_DPAA=m
CONFIG_FSL_MC_DPIO=m
CONFIG_FSL_RCPM=m
CONFIG_FSL_QIXIS=m
CONFIG_SOC_TI=m
CONFIG_EXTCON_PTN5150=m
CONFIG_EXTCON_USB_GPIO=m
CONFIG_EXTCON_USBC_CROS_EC=m
CONFIG_IIO=m
CONFIG_FXLS8962AF_I2C=m
CONFIG_REDACTED8QXP_ADC=m
CONFIG_REDACTED93_ADC=m
CONFIG_MAX9611=m
CONFIG_QCOM_SPMI_VADC=m
CONFIG_QCOM_SPMI_ADC5=m
CONFIG_IIO_CROS_EC_SENSORS_CORE=m
CONFIG_IIO_CROS_EC_SENSORS=m
CONFIG_FXAS21002C=m
CONFIG_FXOS8700_I2C=m
CONFIG_RPMSG_IIO_PEDOMETER=m
CONFIG_INV_ICM42600_I2C=m
CONFIG_IIO_ST_LSM6DSX=m
CONFIG_IIO_CROS_EC_LIGHT_PROX=m
CONFIG_SENSORS_ISL29018=m
CONFIG_VCNL4000=m
CONFIG_BMC150_MAGN_I2C=m
CONFIG_IIO_CROS_EC_BARO=m
CONFIG_MPL3115=m
CONFIG_PWM=m
CONFIG_PWM_ADP5585=m
CONFIG_PWM_CROS_EC=m
CONFIG_PWM_FSL_FTM=m
CONFIG_PWM_REDACTED27=m
CONFIG_PWM_REDACTED_TPM=m
CONFIG_PWM_RPCHIP=m
CONFIG_PWM_SL28CPLD=m
CONFIG_SL28CPLD_INTC=m
CONFIG_RESET_REDACTED7=m
CONFIG_RESET_REDACTED8ULP_SIM=m
CONFIG_PHY_XGENE=m
CONFIG_PHY_MIXEL_LVDS=m
CONFIG_PHY_MIXEL_LVDS_COMBO=m
CONFIG_PHY_CADENCE_SALVO=m
CONFIG_PHY_FSL_REDACTED8MP_LVDS=m
CONFIG_PHY_FSL_REDACTED93_MIPI_DPHY=m
CONFIG_PHY_MIXEL_MIPI_DPHY=m
CONFIG_PHY_SAMSUNG_HDMI_PHY=m
CONFIG_PHY_QCOM_USB_HS=m
CONFIG_PHY_SAMSUNG_USB2=m
CONFIG_ARM_SMMU_V3_PMU=m
CONFIG_FSL_REDACTED8_DDR_PMU=m
CONFIG_FSL_REDACTED9_DDR_PMU=m
CONFIG_HISI_PMU=m
CONFIG_NVMEM_REDACTED_OCOTP=m
CONFIG_NVMEM_REDACTED_OCOTP_SCU=m
CONFIG_NVMEM_RMEM=m
CONFIG_FPGA=m
CONFIG_FPGA_BRIDGE=m
CONFIG_ALTERA_FREEZE_BRIDGE=m
CONFIG_FPGA_REGION=m
CONFIG_OF_FPGA_REGION=m
CONFIG_TEE=m
CONFIG_OPTEE=m
CONFIG_MUX_MMIO=m
CONFIG_SLIM_QCOM_CTRL=m
CONFIG_MXC_SIM=m
# CONFIG_MXC_GPU_VIV is not set
CONFIG_MXC_EMVSIM=m
CONFIG_EXT2_FS=m
CONFIG_EXT3_FS=m
CONFIG_EXT3_FS_POSIX_ACL=m
CONFIG_EXT3_FS_SECURITY=m
CONFIG_BTRFS_FS=m
CONFIG_BTRFS_FS_POSIX_ACL=m
CONFIG_FANOTIFY=m
CONFIG_FANOTIFY_ACCESS_PERMISSIONS=m
CONFIG_QUOTA=m
CONFIG_AUTOFS4_FS=m
CONFIG_FUSE_FS=m
CONFIG_CUSE=m
CONFIG_OVERLAY_FS=m
CONFIG_VFAT_FS=m
CONFIG_TMPFS_POSIX_ACL=m
CONFIG_HUGETLBFS=m
CONFIG_EFIVAR_FS=m
CONFIG_JFFS2_FS=m
CONFIG_UBIFS_FS=m
CONFIG_SQUASHFS=m
CONFIG_SQUASHFS_XZ=m
CONFIG_NFS_FS=m
CONFIG_NFS_V4=m
CONFIG_NFS_V4_1=m
CONFIG_NFS_V4_2=m
CONFIG_ROOT_NFS=m
CONFIG_9P_FS=m
CONFIG_NLS_CODEPAGE_437=m
CONFIG_NLS_ISO8859_1=m
CONFIG_TRUSTED_KEYS=m
# CONFIG_TRUSTED_KEYS_TPM is not set
# CONFIG_TRUSTED_KEYS_TEE is not set
CONFIG_SECURITY=m
CONFIG_SECURITY_SELINUX=m
CONFIG_SECURITY_APPARMOR=m
CONFIG_DEFAULT_SECURITY_DAC=m
CONFIG_CRYPTO_USER=m
CONFIG_CRYPTO_TEST=m
CONFIG_CRYPTO_CHACHA20POLY1305=m
CONFIG_CRYPTO_ECHAINIV=m
CONFIG_CRYPTO_TLS=m
CONFIG_CRYPTO_CFB=m
CONFIG_CRYPTO_CTS=m
CONFIG_CRYPTO_LRW=m
CONFIG_CRYPTO_OFB=m
CONFIG_CRYPTO_PCBC=m
CONFIG_CRYPTO_XCBC=m
CONFIG_CRYPTO_VMAC=m
CONFIG_CRYPTO_MD4=m
CONFIG_CRYPTO_RMD160=m
CONFIG_CRYPTO_STREEBOG=m
CONFIG_CRYPTO_WP512=m
CONFIG_CRYPTO_ANUBIS=m
CONFIG_CRYPTO_ARC4=m
CONFIG_CRYPTO_BLOWFISH=m
CONFIG_CRYPTO_CAMELLIA=m
CONFIG_CRYPTO_CAST5=m
CONFIG_CRYPTO_CAST6=m
CONFIG_CRYPTO_FCRYPT=m
CONFIG_CRYPTO_KHAZAD=m
CONFIG_CRYPTO_SEED=m
CONFIG_CRYPTO_SERPENT=m
CONFIG_CRYPTO_TEA=m
CONFIG_CRYPTO_TWOFISH=m
CONFIG_CRYPTO_ANSI_CPRNG=m
CONFIG_CRYPTO_USER_API_HASH=m
CONFIG_CRYPTO_USER_API_SKCIPHER=m
CONFIG_CRYPTO_USER_API_RNG=m
CONFIG_CRYPTO_USER_API_AEAD=m
CONFIG_CRYPTO_DEV_FSL_CAAM_SECVIO=m
CONFIG_CRYPTO_DEV_FSL_CAAM=m
CONFIG_CRYPTO_DEV_FSL_CAAM_SM_TEST=m
CONFIG_CRYPTO_DEV_FSL_DPAA2_CAAM=m
CONFIG_CRYPTO_DEV_CCREE=m
CONFIG_CRYPTO_DEV_HISI_SEC2=m
CONFIG_CRYPTO_DEV_HISI_ZIP=m
CONFIG_CRYPTO_DEV_HISI_HPRE=m
CONFIG_CRYPTO_DEV_HISI_TRNG=m
CONFIG_CRYPTO_DEV_AMLOGIC_GXL=m
CONFIG_INDIRECT_PIO=m
CONFIG_CRC_CCITT=m
CONFIG_CRC8=m
CONFIG_CMA_SIZE_MBYTES=32
CONFIG_PRINTK_TIME=m
CONFIG_DEBUG_INFO=m
CONFIG_DEBUG_INFO_REDUCED=m
CONFIG_MAGIC_SYSRQ=m
CONFIG_DEBUG_FS=m
CONFIG_DEBUG_KERNEL=m
# CONFIG_SCHED_DEBUG is not set
# CONFIG_DEBUG_PREEMPT is not set
# CONFIG_FTRACE is not set
CONFIG_CORESIGHT=m
CONFIG_CORESIGHT_LINK_AND_SINK_TMC=m
CONFIG_CORESIGHT_SOURCE_ETM4X=m
CONFIG_MEMTEST=m
```
