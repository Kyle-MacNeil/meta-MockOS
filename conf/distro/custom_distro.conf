## conf/distro/custom_distro.conf
```bitbake
# example distro

include conf/distro/include/Vendor-SoM-base-distro.inc

DISTRO = "custom-distro"


# Mask third-party Astrial SOM image bbappend from meta-hailo-apps
BBMASK += "meta-hailo-apps/recipes-images/images/system-astrial-image.bbappend"

# Rewrite legacy TI cgit URLs to active urls
PREMIRRORS:prepend = "\
    git://git.ti.com/cgit/wilink8-wlan/wl18xx_fw git://git.ti.com/git/wilink8-wlan/wl18xx_fw.git;protocol=https \n \
    git://git.ti.com/cgit/wilink8-wlan/wl18xx_fw git://github.com/varigit/wl18xx_fw.git;protocol=https \n \
    git://git.ti.com/cgit/ti-bt/service-packs git://git.ti.com/git/ti-bt/service-packs.git;protocol=https \n \
    git://git.ti.com/cgit/ti-bt/service-packs git://github.com/varigit/ti-bt-service-packs.git;protocol=https \n \
    git://git.ti.com/cgit/wilink8-wlan/18xx-ti-utils git://git.ti.com/git/wilink8-wlan/18xx-ti-utils.git;protocol=https \n \
"
```

## conf/machine/machine.conf
```bitbake
#@TYPE: Machine
#@NAME: J Squared Trax1
#@SOC: i.MX8MP
#@DESCRIPTION: Machine configuration for J Squared Trax1 Carrier Board and VAR-SOM-MX8M-PLUS
#


MACHINEOVERRIDES =. "procssor:vendor-based-SoM"

require conf/machine/include/vendor_base_SoM.inc

# BSP default providers
PREFERRED_PROVIDER_virtual/kernel:vendor-based-SoM ?= "linux-6.x"
PREFERRED_PROVIDER_u-boot:vendor-based-SoM ?= "u-boot-x.x.x"
PREFERRED_PROVIDER_u-boot-fw-utils:vendor-based-SoM ?= "u-boot-fw-utils"
PREFERRED_PROVIDER_virtual/bootloader:vendor-based-SoM ?= "u-boot-x.x.x"

MACHINE_FEATURES += "WIFI"
MACHINE_EXTRA_RRECOMMENDS:append = " ${@bb.utils.contains('MACHINE_FEATURES', 'WIFI', 'WIFI-recipe-name', '', d)}"

# Build and install custom TRAX-1 device tree from meta-trax1/recipes-bsp/device-tree
PREFERRED_PROVIDER_virtual/dtb = "device-tree"
MACHINE_ESSENTIAL_EXTRA_RDEPENDS += "device-tree"
KERNEL_DEVICETREE = ""
IMAGE_BOOT_FILES:append = " custom-device-tree.dtb"

UBOOT_CONFIG ??= "sd"
UBOOT_CONFIG[sd] = "vendor_SoM_config,sdcard"
SPL_BINARY = "spl/u-boot-spl.bin"

ATF_PLATFORM = "ATF-for-vendor-SoM"
ATF_LOAD_ADDR = "0x970000"

# Set DDR FIRMWARE
DDR_FIRMWARE_NAME = " \
	lpddr4_pmu_train_1d_dmem_202006.bin \
	lpddr4_pmu_train_1d_imem_202006.bin \
	lpddr4_pmu_train_2d_dmem_202006.bin \
	lpddr4_pmu_train_2d_imem_202006.bin \
"

# Set U-Boot DTB
UBOOT_DTB_NAME  = "custom-device-tree.dtb"
UBOOT_DTB_EXTRA = "custom-device-tree.dtb"

SERIAL_CONSOLES = "115200;ttymxc0 115200;ttymxc1"

ROOTFS_SIZE = "3700"
LOADADDR = ""
UBOOT_SUFFIX = "bin"
UBOOT_MAKE_TARGET = "all"
IMX_BOOT_SEEK = "32"

PREFERRED_PROVIDER_u-boot:imx8mp-var-dart = "u-boot-variscite"
PREFERRED_PROVIDER_virtual/bootloader:imx8mp-var-dart = "u-boot-variscite"

TEE_CFG_DDR_SIZE ?= "0x100000000"
```
